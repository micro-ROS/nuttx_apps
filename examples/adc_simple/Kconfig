## examples/adc_simple/Kconfig
```kconfig
#
# For a description of the syntax of this configuration file,
# see the file kconfig-language.txt in the NuttX tools repository.
#

config EXAMPLES_ADC_SIMPLE
	bool "Simple example of the ADC"
	default n
	depends on ADC
	---help---
		Enable a simple reading example of the ADC

if EXAMPLES_ADC_SIMPLE

config EXAMPLES_ADC_SIMPLE_PROGNAME
	string "Program name"
	default "adc_simple"
	depends on BUILD_KERNEL
	---help---
		This is the name of the program that will be use when the NSH ELF
		program is installed.

config EXAMPLES_ADC_SIMPLE_PRIORITY
	int "ADC Simple task priority"
	default 100

config EXAMPLES_ADC_SIMPLE_STACKSIZE
	int "ADC simple stack size"
	default 2048

endif
```

## examples/aux_serial/Kconfig
```kconfig
#
# For a description of the syntax of this configuration file,
# see the file kconfig-language.txt in the NuttX tools repository.
#

config EXAMPLES_SERIAL_AUX
	bool "Auxiliar Serial Port"
	default n
	---help---
		Enable the example of use an auxiliar serial port

if EXAMPLES_SERIAL_AUX

config EXAMPLES_SERIAL_AUX_PROGNAME
	string "Program name"
	default "Aux Serial"
	depends on BUILD_LOADABLE
	---help---


config EXAMPLES_SERIAL_AUX_PRIORITY
	int "Aux Serial task priority"
	default 100

config EXAMPLES_SERIAL_AUX_STACKSIZE
	int "Aux Serial stack size"
	default 2048

endif
```

## examples/bmp180/Kconfig
```kconfig
#
# For a description of the syntax of this configuration file,
# see the file kconfig-language.txt in the NuttX tools repository.
#

config EXAMPLES_BMP180
	bool "\"BMP180 pressure sensor\" example"
	default n
	---help---
		Enable the \"BMP180 pressure sensor\" example

if EXAMPLES_BMP180

config EXAMPLES_BMP180_PROGNAME
	string "Program name"
	default "bmp180"
	depends on BUILD_KERNEL
	---help---
		This is the name of the program that will be use when the NSH ELF
		program is installed.

config EXAMPLES_BMP180_PRIORITY
	int "BMP180 task priority"
	default 100

config EXAMPLES_BMP180_STACKSIZE
	int "BMP180 stack size"
	default 2048

endif
```

## examples/date/Kconfig
```kconfig
#
# For a description of the syntax of this configuration file,
# see the file kconfig-language.txt in the NuttX tools repository.
#

config EXAMPLES_DATE
	tristate "date output example"
	default n
	---help---
		Enable the date example

if EXAMPLES_DATE

config EXAMPLES_DATE_PROGNAME
	string "Program name"
	default "date"
	depends on BUILD_LOADABLE
	---help---
		This is the name of the program that will be use when the NSH ELF
		program is installed.

config EXAMPLES_DATE_PRIORITY
	int "Date task priority"
	default 100

config EXAMPLES_DATE_STACKSIZE
	int "Date stack size"
	default 2048

endif
```

## examples/demo_distance/Kconfig
```kconfig
config UROS_EXAMPLES_DEMO_DISTANCE_PUBLISHER
	bool "uROS demo Distance publisher"
	default n
	depends on UROS
	---help---
		Enable the demonstration demo publisher uROS example

if UROS_EXAMPLES_DEMO_DISTANCE_PUBLISHER

config UROS_EXAMPLES_DEMO_DISTANCE_PUBLISHER_PROGNAME
	string "Program name"
	default "demo distance publisher"
	depends on BUILD_KERNEL
	---help---
		This is the name of the program that will be use when the NSH ELF
		program is installed.

#config UROS_EXAMPLES_PUBLISHER_PRIORITY
#	int "Publisher task priority"
#	default 100
#
#config UROS_EXAMPLES_PUBLISHER_STACKSIZE
#	int "Publisher stack size"
#	default 2048

endif
```

## examples/demo_power/Kconfig
```kconfig
config UROS_EXAMPLES_DEMO_POWER_PUBLISHER
	bool "uROS demo Power publisher"
	default n
	depends on UROS
	---help---
		Enable the demonstration power publisher uROS example

if UROS_EXAMPLES_DEMO_POWER_PUBLISHER

config UROS_EXAMPLES_DEMO_POWER_PUBLISHER_PROGNAME
	string "Program name"
	default "demo_power"
	depends on BUILD_KERNEL
	---help---
		This is the name of the program that will be use when the NSH ELF
		program is installed.

#config UROS_EXAMPLES_PUBLISHER_PRIORITY
#	int "Publisher task priority"
#	default 100
#
#config UROS_EXAMPLES_PUBLISHER_STACKSIZE
#	int "Publisher stack size"
#	default 2048

endif
```

## examples/hih6130/Kconfig
```kconfig
#
# For a description of the syntax of this configuration file,
# see the file kconfig-language.txt in the NuttX tools repository.
#

config EXAMPLES_HIH6130
	bool "\"HIH6130 humidity/temperature sensor\" example"
	default n
	---help---
		Enable the \"HIH6130 humidity/temperature sensor\" example

if EXAMPLES_HIH6130

config EXAMPLES_HIH6130_PROGNAME
	string "Program name"
	default "hih6130"
	depends on BUILD_KERNEL
	---help---
		This is the name of the program that will be use when the NSH ELF
		program is installed.

config EXAMPLES_HIH6130_PRIORITY
	int "HIH6130 task priority"
	default 100

config EXAMPLES_HIH6130_STACKSIZE
	int "HIH6130 stack size"
	default 2048

endif
```

## examples/js/Kconfig
```kconfig
#
# For a description of the syntax of this configuration file,
# see the file kconfig-language.txt in the NuttX tools repository.
#

config EXAMPLES_JOYSTICK
	tristate "USB Joystick Logitech extreme 3D PRO"
	default n
	---help---
		Enable the USB Joystick Logitech extreme 3D PRO

if EXAMPLES_JOYSTICK

config EXAMPLES_JOYSTICK_PROGNAME
	string "Program name"
	default "joystick"
	depends on BUILD_LOADABLE
	---help---
		This is the name of the program that will be use when the joystick 
		program is installed.

config EXAMPLES_JOYSTICK_STACKSIZE
	int "Task stack size"
	default 2048
endif
```

## examples/jsmotor/Kconfig
```kconfig
#
# For a description of the syntax of this configuration file,
# see the file kconfig-language.txt in the NuttX tools repository.
#

config EXAMPLES_MOTOR_JOYSTICK
	tristate "Tupec demo - Joystick Logitech 3D PRO driver for motor test"
	default n
	---help---
		Enable the USB Joystick Logitech extreme 3D PRO for motor

if EXAMPLES_MOTOR_JOYSTICK

config EXAMPLES_MOTOR_JOYSTICK_PROGNAME
	string "Program name"
	default "jsmotor"
	depends on BUILD_LOADABLE
	---help---
		This is the name of the program that will be use when the program for  
		motor joystick is installed.

config EXAMPLES_MOTOR_JOYSTICK_STACKSIZE
	int "Task stack size"
	default 2048
endif
```

## examples/jspublisher/Kconfig
```kconfig
config UROS_EXAMPLES_JSPUBLISHER
	bool "TUPEK demo - microROS 6lowpan Joystick Publisher"
	default n
	depends on UROS
	---help---
		Enable the uROS 3D PRO Joystick publisher over 6lowpan 

if UROS_EXAMPLES_JSPUBLISHER

config UROS_EXAMPLES_JSPUBLISHER_PROGNAME
	string "Program name"
	default "jspublisher"
	depends on BUILD_KERNEL
	---help---
		This is the name of the program that will be use when the NSH ELF
		program is installed.

#config UROS_EXAMPLES_PUBLISHER_PRIORITY
#	int "Publisher task priority"
#	default 100
#
#config UROS_EXAMPLES_PUBLISHER_STACKSIZE
#	int "Publisher stack size"
#	default 2048

endif
```

## examples/jssubscriber/Kconfig
```kconfig
config UROS_EXAMPLES_JSSUBSCRIBER
	bool "TUPEK demo - uROS 6lowpan Motor Subscriber"
	default n
	depends on UROS
	---help---
		Enable the uROS motor subscriber over 6lowpan 

if UROS_EXAMPLES_JSSUBSCRIBER

config UROS_EXAMPLES_JSSUBSCRIBER_PROGNAME
	string "Program name"
	default "jssubscriber"
	depends on BUILD_KERNEL
	---help---
		This is the name of the program that will be use when the NSH ELF
		program is installed.

#config UROS_EXAMPLES_SUBSCRIBER_PRIORITY
#	int "Subscriber task priority"
#	default 100
#
#config UROS_EXAMPLES_SUBSCRIBER_STACKSIZE
#	int "Subscriber stack size"
#	default 2048

endif
```

## examples/kobuki/Kconfig
```kconfig
config UROS_EXAMPLES_KOBUKI
	bool "uROS Kobuki"
	default n
	depends on UROS
	---help---
		Enable the subscriber uROS example

if UROS_EXAMPLES_KOBUKI

config UROS_EXAMPLES_KOBUKI_PROGNAME
	string "Program name"
	default "kobuki"
	depends on BUILD_KERNEL
	---help---
		This is the name of the program that will be use when the NSH ELF
		program is installed.

#config UROS_EXAMPLES_KOBUKI_PRIORITY
#	int "Kobuki task priority"
#	default 100
#
config UROS_EXAMPLES_KOBUKI_STACKSIZE
	int "Kobuki stack size"
	default 65000

endif
```

## examples/kobuki_tof/Kconfig
```kconfig
config UROS_EXAMPLES_KOBUKI_TOF
	bool "uROS Kobuki TOF sensor"
	default n
	depends on UROS
	---help---
		Enable the subscriber uROS example

if UROS_EXAMPLES_KOBUKI_TOF

config UROS_EXAMPLES_KOBUKI_TOF_PROGNAME
	string "Program name"
	default "kobuki_tof"
	depends on BUILD_KERNEL
	---help---
		This is the name of the program that will be use when the NSH ELF
		program is installed.

#config UROS_EXAMPLES_KOBUKI_TOF_PRIORITY
#	int "Kobuki task priority"
#	default 100
#
config UROS_EXAMPLES_KOBUKI_TOF_STACKSIZE
	int "Kobuki tof stack size"
	default 65000

endif
```

## examples/microros/Kconfig
```kconfig
config UROS_EXAMPLES_MICROROS
	bool "microros"
	default n
	depends on MICROROSLIB
	---help---
		Enable the microros example

if UROS_EXAMPLES_MICROROS

config UROS_EXAMPLES_MICROROS_PROGNAME
	string "Program name"
	default "microros"
	depends on BUILD_KERNEL
	---help---
		This is the name of the program that will be use when the NSH ELF
		program is installed.

#config UROS_EXAMPLES_MICROROS_PRIORITY
#	int "MICROROS task priority"
#	default 100
#
#config UROS_EXAMPLES_MICROROS_STACKSIZE
#	int "MICROROS stack size"
#	default 2048

endif
```

## examples/motor/Kconfig
```kconfig
#
# For a description of the syntax of this configuration file,
# see the file kconfig-language.txt in the NuttX tools repository.
#

config EXAMPLES_MOTOR
	tristate "Tupec demo - Motor driver test"
	default n
	---help---
		Enable the Motor example

if EXAMPLES_MOTOR

config EXAMPLES_MOTOR_PROGNAME
	string "Program name"
	default "motor"
	depends on BUILD_LOADABLE
	---help---
		This is the name of the program that will be use when the motor

config EXAMPLES_MOTOR_PRIORITY
	int "Motor task priority"
	default 100

config EXAMPLES_MOTOR_STACKSIZE
	int "Motor stack size"
	default 2048

endif
```

## examples/myapp/Kconfig
```kconfig
config UROS_EXAMPLES_MYAPP
	bool "uROS Myapp"
	default n
	depends on UROS
	---help---
		Enable the publisher uROS example

if UROS_EXAMPLES_MYAPP

config UROS_EXAMPLES_MYAPP_PROGNAME
	string "Program name"
	default "myapp"
	depends on BUILD_KERNEL
	---help---
		This is the name of the program that will be use when the NSH ELF
		program is installed.

#config UROS_EXAMPLES_MYAPP_PRIORITY
#	int "Myapp task priority"
#	default 100
#
#config UROS_EXAMPLES_MYAPP_STACKSIZE
#	int "Myapp stack size"
#	default 2048

endif
```

## examples/publisher_hih6130/Kconfig
```kconfig
config MICRO_ROS_EXAMPLES_PUBLISHER_HIH6130
	bool "micro-ROS HIH6130 Publisher Example"
	default n
	depends on UROS
	---help---
		Enable the HIH6130 publisher micro-ROS example

if MICRO_ROS_EXAMPLES_PUBLISHER_HIH6130

config MICRO_ROS_EXAMPLES_PUBLISHER_HIH6130_PROGNAME
	string "Program name"
	default "publisher_hih6130"
	depends on BUILD_KERNEL
	---help---
		This is the name of the program that will be use when the NSH ELF
		program is installed.


endif
```

## examples/subscriber/Kconfig
```kconfig
config UROS_EXAMPLES_SUBSCRIBER
	bool "microROS Subscriber"
	default n
	depends on UROS
	---help---
		Enable the subscriber uROS example

if UROS_EXAMPLES_SUBSCRIBER

config UROS_EXAMPLES_SUBSCRIBER_PROGNAME
	string "Program name"
	default "subscriber"
	depends on BUILD_KERNEL
	---help---
		This is the name of the program that will be use when the NSH ELF
		program is installed.

#config UROS_EXAMPLES_SUBSCRIBER_PRIORITY
#	int "Subscriber task priority"
#	default 100
#
#config UROS_EXAMPLES_SUBSCRIBER_STACKSIZE
#	int "Subscriber stack size"
#	default 2048

endif
```

## examples/telemetry/Kconfig
```kconfig
#
# For a description of the syntax of this configuration file,
# see the file kconfig-language.txt in the NuttX tools repository.
#

config EXAMPLES_TELEMETRY
	bool "Performance Telemetry App" example"
	default n
	---help---
		With this app you can see an example ussage of different tools to control the MCU.

if EXAMPLES_TELEMETRY

config EXAMPLES_TELEMETRY_PROGNAME
	string "Program name"
	default "telemetry"
	depends on BUILD_KERNEL
	---help---
		This is the name of the program that will be use when the NSH ELF
		program is installed.

config EXAMPLES_TELEMETRY_PRIORITY
	int "Telemetry task priority"
	default 100

config EXAMPLES_TELEMETRY_STACKSIZE
	int "Telemetry stack size"
	default 2048

endif
```

## examples/testutils/Kconfig
```kconfig
config EXAMPLES_TESTUTILS
	tristate "test-utils example"
	default n
	select NETUTILS_ESP8266
	---help---
		Enable the test-utils example
```

## examples/ucs_6lowpan/Kconfig
```kconfig
config UCS_6LOWPAN_EXAMPLE
	bool "ucs - microROS Publisher/Subscriber 6LoWPAN"
	default n
	depends on UROS
	---help---
		Enable the uROS test publisher/subscriber example over 6LoWPAN radio communication

if UCS_6LOWPAN_EXAMPLE

config UCS_6LOWPAN_EXAMPLE_PROGNAME
	string "Program name"
	default "ucs_6lowpan"
	depends on BUILD_KERNEL
	---help---
		This is the name of the program that will be use when the NSH ELF
		program is installed.


endif
```

## examples/ucs_distance/Kconfig
```kconfig
config UCS_DISTANC_EXAMPLE
	bool "UCS - microROS TFMINI Publisher over 6LoWPAN"
	default n
	depends on MICROROSLIB
	---help---
		Enable the uROS TFMini distance publisher over 6LoWPAN radio communication

if UCS_DISTANC_EXAMPLE

config UCS_DISTANC_EXAMPLE_PROGNAME
	string "Program name"
	default "ucs_distance"
	depends on BUILD_KERNEL
	---help---
		This is the name of the program that will be use when the NSH ELF
		program is installed.

endif
```

## examples/ucs_effector/Kconfig
```kconfig
config UCS_EFFECTOR_EXAMPLE
	bool "UCS - microROS EFFECTOR Subscriber over 6LoWPAN"
	default n
	depends on UROS
	---help---
		Enable the uROS finala effector subscriber over 6LoWPAN radio communication

if UCS_EFFECTOR_EXAMPLE

config UCS_EFFECTOR_EXAMPLE_PROGNAME
	string "Program name"
	default "ucs_effector"
	depends on BUILD_KERNEL
	---help---
		This is the name of the program that will be use when the NSH ELF
		program is installed.

endif
```

## examples/ucs_hih6130/Kconfig
```kconfig
config UCS_HIH6130_EXAMPLE
	bool "UCS - microROS HIH6130 Publisher over 6LoWPAN"
	default n
	depends on MICROROSLIB
	---help---
		Enable the uROS HIH6130 humidity publisher over 6LoWPAN radio communication

if UCS_HIH6130_EXAMPLE

config UCS_HIH6130_EXAMPLE_PROGNAME
	string "Program name"
	default "ucs_hih6130"
	depends on BUILD_KERNEL
	---help---
		This is the name of the program that will be use when the NSH ELF
		program is installed.

endif
```

## examples/ucs_opener/Kconfig
```kconfig
config UCS_OPENER_EXAMPLE
	bool "UCS - microROS OPENER Subcriber over 6LoWPAN"
	default n
	depends on UROS
	---help---
		Enable the uROS door opener subscriber over 6LoWPAN radio communication

if UCS_OPENER_EXAMPLE

config UCS_OPENER_EXAMPLE_PROGNAME
	string "Program name"
	default "ucs_opener"
	depends on BUILD_KERNEL
	---help---
		This is the name of the program that will be use when the NSH ELF
		program is installed.


endif
```
