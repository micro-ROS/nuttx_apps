## examples/ucs_pub/Kconfig
```kconfig
config UCS_PUB_EXAMPLE
	bool "UCS - microROS Opener/Effector Publisher over 6LoWPAN"
	default n
	depends on UROS
	---help---
		Enable the ucs test publisher over 6LoWPAN radio communication

if UCS_PUB_EXAMPLE

config UCS_PUB_EXAMPLE_PROGNAME
	string "Program name"
	default "ucs_pub"
	depends on BUILD_KERNEL
	---help---
		This is the name of the program that will be use when the NSH ELF
		program is installed.

 config UCS_PUB_EXAMPLE_TOPIC_SELECTOR
 	int "ucs demo topic selector"
 	default 1
	depends on UCS_PUB_EXAMPLE
	---help---
		Set 1 to use ucs demo opener topic. Set 0 to publish effector commannds.

endif
```

## examples/ucs_sub/Kconfig
```kconfig
config UCS_SUB_EXAMPLE
	bool "UCS - microROS Distance Subscriber over 6LoWPAN"
	default n
	depends on UROS
	---help---
		Enable the ucs test subscriber over 6LoWPAN radio communication

if UCS_SUB_EXAMPLE

config UCS_SUB_EXAMPLE_PROGNAME
	string "Program name"
	default "ucs_sub"
	depends on BUILD_KERNEL
	---help---
		This is the name of the program that will be use when the NSH ELF
		program is installed.

 config UCS_SUB_EXAMPLE_TOPIC_SELECTOR
 	int "ucs demo topic selector"
 	default 1
	depends on UCS_SUB_EXAMPLE
	---help---
		Set 1 to use ucs demo distance topic..

endif
```

## examples/udp_6lowpan/Kconfig
```kconfig
#
# For a description of the syntax of this configuration file,
# see the file kconfig-language.txt in the NuttX tools repository.
#

config EXAMPLES_UDP_6LOWPAN
	tristate "UDP 6lowpan example"
	default n
	---help---
		Enable the UDP 6lowpan example

if EXAMPLES_UDP_6LOWPAN

config EXAMPLES_UDP_6LOWPAN_PROGNAME
	string "Program name"
	default "udp_6lowpan"
	depends on BUILD_LOADABLE
	---help---
		This is the name of the program that will be use when the NSH ELF
		program is installed.

config EXAMPLES_UDP_6LOWPAN_PRIORITY
	int "UDP_6lowpan task priority"
	default 100

config EXAMPLES_UDP_6LOWPAN_STACKSIZE
	int "UDP_6lowpan stack size"
	default 2048

endif
```

## examples/udpecho/Kconfig
```kconfig
#
# For a description of the syntax of this configuration file,
# see the file kconfig-language.txt in the NuttX tools repository.
#

config EXAMPLES_UDPECHO
	bool "\"UDP Echo server\" example"
	default n
	---help---
		Enable the \"UDP Echo server\" example

if EXAMPLES_UDPECHO

config EXAMPLES_UDPECHO_PROGNAME
	string "Program name"
	default "udpecho"
	depends on BUILD_KERNEL
	---help---
		This is the name of the program that will be use when the NSH ELF
		program is installed.

config EXAMPLES_UDPECHO_PRIORITY
	int "UDPEcho task priority"
	default 100

config EXAMPLES_UDPECHO_STACKSIZE
	int "UDPEcho stack size"
	default 2048

endif
```

## examples/uros/Kconfig
```kconfig
menuconfig UROS_EXAMPLES
	tristate "UROS Examples"
	default n
	---help---
		Enable the uROS examples.

if UROS_EXAMPLES

config UROS_EXAMPLES_PUBLISHER
	bool "uROS Publisher"
	default n
	depends on UROS
	---help---
		Enable the publisher uROS example

if UROS_EXAMPLES_PUBLISHER

config UROS_EXAMPLES_PUBLISHER_PROGNAME
	string "Program name"
	default "publisher"
	depends on BUILD_KERNEL
	---help---
		This is the name of the program that will be use when the NSH ELF
		program is installed.

#config UROS_EXAMPLES_PUBLISHER_PRIORITY
#	int "Publisher task priority"
#	default 100
#
#config UROS_EXAMPLES_PUBLISHER_STACKSIZE
#	int "Publisher stack size"
#	default 2048

endif


config UROS_EXAMPLES_SUBSCRIBER
	bool "uROS Subscriber"
	default n
	depends on UROS
	---help---
		Enable the subscriber uROS example

if UROS_EXAMPLES_SUBSCRIBER

config UROS_EXAMPLES_SUBSCRIBER_PROGNAME
	string "Program name"
	default "subscriber"
	depends on BUILD_KERNEL
	---help---
		This is the name of the program that will be use when the NSH ELF
		program is installed.

#config UROS_EXAMPLES_SUBSCRIBER_PRIORITY
#	int "Subscriber task priority"
#	default 100
#
#config UROS_EXAMPLES_SUBSCRIBER_STACKSIZE
#	int "Subscriber stack size"
#	default 2048

endif


endif # UROS_EXAMPLES
```

## examples/uros/publisher/Kconfig
```kconfig
#
# For a description of the syntax of this configuration file,
# see the file kconfig-language.txt in the NuttX tools repository.
#

config UROS_EXAMPLES_PUBLISHER
	bool "uROS Publisher"
	default n
	depends on UROS
	---help---
		Enable the publisher uROS example

if UROS_EXAMPLES_PUBLISHER

config UROS_EXAMPLES_PUBLISHER_PROGNAME
	string "Program name"
	default "publisher"
	depends on BUILD_KERNEL
	---help---
		This is the name of the program that will be use when the NSH ELF
		program is installed.

#config UROS_EXAMPLES_PUBLISHER_PRIORITY
#	int "Publisher task priority"
#	default 100
#
#config UROS_EXAMPLES_PUBLISHER_STACKSIZE
#	int "Publisher stack size"
#	default 2048

endif
```

## examples/uros/subscriber/Kconfig
```kconfig
#
# For a description of the syntax of this configuration file,
# see the file kconfig-language.txt in the NuttX tools repository.
#

config UROS_EXAMPLES_SUBSCRIBER
	bool "uROS Subscriber"
	default n
	depends on UROS
	---help---
		Enable the subscriber uROS example

if UROS_EXAMPLES_SUBSCRIBER

config UROS_EXAMPLES_SUBSCRIBER_PROGNAME
	string "Program name"
	default "subscriber"
	depends on BUILD_KERNEL
	---help---
		This is the name of the program that will be use when the NSH ELF
		program is installed.

#config UROS_EXAMPLES_SUBSCRIBER_PRIORITY
#	int "Subscriber task priority"
#	default 100
#
#config UROS_EXAMPLES_SUBSCRIBER_STACKSIZE
#	int "Subscriber stack size"
#	default 2048

endif
```

## examples/uros_6lowpan/Kconfig
```kconfig
config UROS_6LOWPAN_EXAMPLE
	bool "microROS Publisher/Subscriber 6LoWPAN"
	default n
	depends on UROS
	---help---
		Enable the publisher/subscriber example over 6LoWPAN radio communication

if UROS_6LOWPAN_EXAMPLE

config UROS_6LOWPAN_EXAMPLE_PROGNAME
	string "Program name"
	default "uros_6lowpan"
	depends on BUILD_KERNEL
	---help---
		This is the name of the program that will be use when the NSH ELF
		program is installed.

config UROS_6LOWPAN_EXAMPLE_ID
	hex "6LoWPAN device ID"
	default 00
	depends on UROS_6LOWPAN_EXAMPLE
	---help---
		ID of the 6LoWPAN radio. It must be between 00 and FF

endif
```

## examples/uros_delay_test/Kconfig
```kconfig
config UROS_DELAY_TEST
	bool "microROS Delay Test"
	default n
	depends on UROS
	---help---
		Enable the Micro-ROS delay test

if UROS_DELAY_TEST

config UROS_DELAY_TEST_PROGNAME
	string "Program name"
	default "delay_test"
	depends on BUILD_KERNEL
	---help---
		This is the name of the program that will be use when the NSH ELF
		program is installed.

#config UROS_DELAY_TEST_PRIORITY
#	int "Publisher task priority"
#	default 100
#
#config UROS_DELAY_TEST_STACKSIZE
#	int "Publisher stack size"
#	default 2048

endif
```

## examples/uros_pingpong/Kconfig
```kconfig
config UROS_PINGPONG_EXAMPLE
	bool "micro-ROS Ping Pong"
	default n
	depends on UROS
	---help---
		micro-ROS Ping Pong sample app

if UROS_PINGPONG_EXAMPLE

config UROS_PINGPONG_EXAMPLE_PROGNAME
	string "Program name"
	default "uros_ping_pong"
	depends on BUILD_KERNEL
	---help---
		This is the name of the program that will be use when the NSH ELF
		program is installed.

endif
```

## examples/uros_pong_server/Kconfig
```kconfig
config UROS_PONG_SERVER
	bool "microROS Pong Server"
	default n
	depends on UROS
	---help---
		Listen on the /uros_ping topic and replies to /uros_pong, to enable
		Round-Trip-Time measurements.

if UROS_PONG_SERVER

config UROS_PONG_SERVER_PROGNAME
	string "Program name"
	default "uros_pong"
	depends on BUILD_KERNEL
	---help---
		This is the name of the program that will be use when the NSH ELF
		program is installed.

endif
```

## examples/uros_publisher/Kconfig
```kconfig
#
# For a description of the syntax of this configuration file,
# see the file kconfig-language.txt in the NuttX tools repository.
#

config EXAMPLES_UROS
	bool "uROS example"
	default n
	depends on UROS
	---help---
		Enable the uROS example

if EXAMPLES_UROS

config EXAMPLES_UROS_PROGNAME
	string "Program name"
	default "publisher"
	depends on BUILD_KERNEL
	---help---
		This is the name of the program that will be use when the NSH ELF
		program is installed.

#config EXAMPLES_CLIENT_PRIORITY
#	int "Client task priority"
#	default 100
#
#config EXAMPLES_CLIENT_STACKSIZE
#	int "Client stack size"
#	default 2048

endif
```

## examples/vl53l1x/Kconfig
```kconfig
#
# For a description of the syntax of this configuration file,
# see the file kconfig-language.txt in the NuttX tools repository.
#

config EXAMPLES_VL53L1X_DEMO
	tristate "\"VL53L1X_DEMO\" example"
	default n
	---help---
		Enable the \"VL53L1X_DEMO\" example

if EXAMPLES_VL53L1X_DEMO

config EXAMPLES_VL53L1X_DEMO_PROGNAME
	string "Program name"
	default "VL53L1X_DEMO"
	depends on BUILD_LOADABLE
	---help---
		This is the name of the program that will be use when the NSH ELF
		program is installed.

config EXAMPLES_VL53L1X_DEMO_PRIORITY
	int "VL53L1X_DEMO priority"
	default 100

config EXAMPLES_VL53L1X_DEMO_STACKSIZE
	int "VL53L1X_DEMO size"
	default 2048

endif
```

## microxrcedds/Kconfig
```kconfig
# Kconfig for Micro XRCE-DDS 

menu "Micro XRCE-DDS"

config MICRO_XRCE_CLIENT
    bool "Enable Micro XRCE-DDS Client"
    default n
    ---help---
        Enable support for Micro XRCE-DDS Client

if MICRO_XRCE_CLIENT

comment "Micro XRCE-DDS Options"

config MR_PROFILE_CREATE_ENTITIES_REF
        bool "Create Entities by Reference profile"
        default y
        ---help---
            Enable the Create Entities by Reference profile.

config MR_PROFILE_CREATE_ENTITIES_XML
        bool "Create Entities by XML profile"
        default y
        ---help---
            Enable the Create Entities by XML profile.

config MR_PROFILE_READ_ACCESS
        bool "Read Access profile"
        default y
        ---help---
            Enable Read Acces profile.

config MR_PROFILE_SERIAL_TRANSPORT 
        bool "Serial Transport profile"
        default y
        ---help---
            Enable the Serial Transport profile.

if MR_PROFILE_SERIAL_TRANSPORT

config MR_SERIAL_TRANSPORT_MTU
        int "Serial Transport MTU"
        default 512
        ---help---
            Serial Transport MTU.

endif # MR_PROFILE_SERIAL_TRANSPORT

config MR_PROFILE_UDP_TRANSPORT 
        bool "UDP Transport profile"
        default n 
        depends on NET_UDP
        ---help---
            Enable the UDP Transport profile.

if MR_PROFILE_UDP_TRANSPORT

config MR_UDP_TRANSPORT_MTU
        int "UDP Transport MTU"
        default 512
        ---help---
            UDP Transport MTU.

endif # MR_PROFILE_UDP_TRANSPORT

config MR_PROFILE_TCP_TRANSPORT 
        bool "TCP Transport profile"
        default n
        depends on NET_TCP
        ---help---
            Enable the TCP Transport profile.

if MR_PROFILE_TCP_TRANSPORT

config MR_TCP_TRANSPORT_MTU
        int "TCP Transport MTU"
        default 512
        ---help---
            TCP Transport MTU.

endif # MR_PROFILE_TCP_TRANSPORT

config MR_MAX_OUTPUT_BEST_EFFORT_STREAMS 
        int "Output Best-Effort streams"
        default 1
        ---help---
            Number of Output Best-Effort streams.

config MR_MAX_OUTPUT_RELIABLE_STREAMS 
        int "Output Reliable streams"
        default 1
        ---help---
            Number of output reliable streams.

config MR_MAX_INPUT_BEST_EFFORT_STREAMS 
        int "Input Best-Effort streams"
        default 1
        ---help---
            Number of Input Best-Effort streams.

config MR_MAX_INPUT_RELIABLE_STREAMS 
        int "Input Reliable streams"
        default 1
        ---help---
            Number of Input Reliable streams.

config MR_MAX_SESSION_CONNECTION_ATTEMPTS
        int "Maximum session connections attempts"
        default 10
        ---help---
            Maximum number of session connections attempts.

config MR_MIN_SESSION_CONNECTION_INTERVAL
        int "Minimum session connections intermal (ms)"
        default 1
        ---help---
            Minimum session connections internal in milliseconds.

config MR_MIN_HEARTBEAT_TIME_INTERVAL
        int "Minimum heartbeat time intermal (ms)"
        default 1
        ---help---
            Minimum heartbeat time internal in milliseconds.

config MICRO_XRCE_VERBOSE_OUTPUT
        bool "Enable verbose output"
        default y
        ---help---
            Enable verbose output usefull for debugging.

endif # MICRO_XRCE_CLIENT

endmenu # Micro XRCE-DDS 
```

## uros/Kconfig
```kconfig
# Kconfig for micro-ROS

menu "micro-ROS"

config UROS
    bool "Enable micro-ROS"
    default n
    ---help---
        Enable support for micro-ROS 

if UROS

config UROS_DIR
    string "micro-ROS workspace (relative to NuttX)"
    default "../mcu_ws/"
    ---help---
	Location of the micro-ROS workspace.

choice 
	prompt "Transport"
	default UROS_TRANSPORT_UDP if CONFIG_NET_UDP
	default UROS_TRANSPORT_SERIAL if CONFIG_SERIAL

config UROS_TRANSPORT_UDP
  bool "UDP transport"

  ---help---
    Uses UDP for the connection to agent.

config UROS_TRANSPORT_SERIAL
  bool "Serial transport"
  
  ---help---
     Uses a serial interface for the connection to the agent.

endchoice


config UROS_IP_VERSION
	string "The IP version either ipv4 or ipv6"
	default "ipv6"


if UROS_TRANSPORT_UDP
  config UROS_AGENT_IP
    string "IP address of the agent"
    default "127.0.0.1"
  
  config UROS_AGENT_PORT
    int "Port number of the agent"
    default 8888
  
endif

if UROS_TRANSPORT_SERIAL
  config UROS_SERIAL_PORT
    string "Serial port to use"
    default "/dev/ttyS0"
  
endif

config UROS_MAX_NODES
  int "Maximum number of nodes"
  default 2

config UROS_MAX_PUBLISHERS
  int "Maximum number of publishers"
  default 2

config UROS_MAX_SUBSCRIPTIONS
  int "Maximum number of subscriptions"
  default 2

config UROS_MAX_SERVICES
  int "Maximum number of service handlers"
  default 1
  ---help---
    This is the maximum number of services. Please note that parameter service, if used, needs one of those.

config UROS_MAX_CLIENTS
  int "Maximum number of service clients"
  default 1

config UROS_MAX_HISTORY
  int "Maximum message history length"
  default 2

config UROS_XML_BUFFER_LENGTH
  int "Length of internal XML buffer. DO NOT CHANGE"
  default 400

endif

endmenu # UROS
```
